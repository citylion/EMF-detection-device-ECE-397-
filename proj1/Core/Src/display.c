/*
 * display.c
 *
 *  Created on: Feb 27, 2025
 *      Author: citylion
 */


/*
/ Program for writing to NHD-2.8-25664 OLED with SSD1322 controller with Serial Interface
/
/
/ Newhaven Display invests time and resources providing this open source code,

* Parts Copyright (c) 2019, Newhaven Display International
*
* This code is provided as an example only and without any warranty by Newhaven Display.
* Newhaven Display accepts no responsibility for any issues resulting from its use.
* The developer of the final application incorporating any parts of this
* sample code is responsible for ensuring its safe and correct operation
* and for any consequences resulting from its use.
* See the GNU General Public License for more details.
*
* Use Horizontal Orientation when converting BMP to hex code to display custom image using LCD assistant.
*/
//---------------------------------------------------------
#include "main.h"
#include "utils.h"

extern SPI_HandleTypeDef hspi1;


#define HIGH 1
#define LOW 0

/****************************************************
*               Hex Table for Image Pic             *
*****************************************************/
unsigned char NHD_Logo [] = {
0x00, 0x00, 0x00, 0x00, 0x00, 0x00, 0x00, 0x00, 0x00, 0x00, 0x00, 0x00, 0x00, 0x00, 0x00, 0x00,
0x00, 0x00, 0x00, 0x00, 0x00, 0x00, 0x00, 0x00, 0x00, 0x00, 0x00, 0x00, 0x00, 0x00, 0x00, 0x00,
0x00, 0x00, 0x00, 0x00, 0x00, 0x00, 0x00, 0x00, 0x00, 0x00, 0x00, 0x00, 0x00, 0x00, 0x00, 0x00,
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0x00, 0x00, 0x00, 0x00, 0x00, 0x00, 0x00, 0x00, 0x00, 0x00, 0x00, 0x00, 0x00, 0x00, 0x00, 0x00
};

unsigned char buffer [2048];

/****************************************************
*                 Function Commands                  *
*****************************************************/



void data(unsigned char d)
{
    // 1. Pull CS low to select the OLED
    HAL_GPIO_WritePin(DISP_GPIO_CS_GPIO_Port, DISP_GPIO_CS_Pin, 0);

    // 2. Set D/C high to indicate "data" (rather than command)
    HAL_GPIO_WritePin(DISP_GPIO_DC_GPIO_Port, DISP_GPIO_DC_Pin, 1);

    // 3. Transmit the byte via SPI
    HAL_SPI_Transmit(&hspi1, &d, 1, HAL_MAX_DELAY);

    // 4. Pull CS high to finish the transaction
    HAL_GPIO_WritePin(DISP_GPIO_CS_GPIO_Port, DISP_GPIO_CS_Pin, 1);
}


void command(unsigned char d) //Command Output Serial Interface
{

  HAL_GPIO_WritePin(DISP_GPIO_CS_GPIO_Port, DISP_GPIO_CS_Pin, 0);
  HAL_GPIO_WritePin(DISP_GPIO_DC_GPIO_Port, DISP_GPIO_DC_Pin, 0);

  HAL_SPI_Transmit(&hspi1, &d, 1, HAL_MAX_DELAY);

  HAL_GPIO_WritePin(DISP_GPIO_DC_GPIO_Port, DISP_GPIO_DC_Pin, 1);
  HAL_GPIO_WritePin(DISP_GPIO_CS_GPIO_Port, DISP_GPIO_CS_Pin, 1);
}

/****************************************************
*                 Display Commands                   *
*****************************************************/

void Set_Column_Address_25664(unsigned char a, unsigned char b)
{
  command(0x15);  // Set Column Address
  data(a);        //   Default => 0x00
  data(b);        //   Default => 0x77
}
//--------------------------------------------------------------------------

void Set_Write_RAM_25664()
{
  command(0x5C);  // Enable MCU to Write DATA RAM
}
//--------------------------------------------------------------------------

void Set_Read_RAM_25664()
{
  command(0x5D);  // Enable MCU to Write DATA RAM
}
//--------------------------------------------------------------------------

void Set_Row_Address_25664(unsigned char a, unsigned char b)
{
  command(0x75);  // Set Row Start and End Address
  data(a);        // Default => 0x00
  data(b);        // Default => 0x7F
}
//--------------------------------------------------------------------------

void Set_Remap_25664(unsigned char a, unsigned char b)
{
  command(0xA0);  // Set Remap
  data(a);        // Default => 0x00
  data(b);        // Default => 0x00
}
//--------------------------------------------------------------------------

void Set_Display_Start_Line_25664(unsigned char a)
{
  command(0xA1);  // Set Display RAM Display Start Line
  data(a);        // Default => 0x00
}
//--------------------------------------------------------------------------

void Set_Display_Offset_25664(unsigned char a)
{
  command(0xA2);  // Set Verticle Shift
  data(a);        // Default => 0x00
}
//--------------------------------------------------------------------------

void Display_Mode_25664(unsigned char a)
{
  command(a);     // 0xA4 => Entire Display OFF
                  // 0xA5 => Entire Display ON, all pixels Grayscale level 15
                  // 0xA6 => Normal Display (Default)
                  // 0xA7 => Inverse Display
}
//--------------------------------------------------------------------------

void Enable_Partial_Display_25664(unsigned char a, unsigned char b)
{
  command(0xA8);  // Turns ON partial mode
  data(a);        // Address of start row
  data(b);        // Address of end row.
}
//--------------------------------------------------------------------------

void Exit_Partial_Display_25664()
{
  command(0xA9);  // Exit Partial Display Mode
}
//--------------------------------------------------------------------------

void Function_Selection_25664(unsigned char a)
{
  command(0xAB);  // Function Selection
  data(a);        // Default => 0x01
}
//--------------------------------------------------------------------------

void Set_Sleep_Mode_25664(unsigned char a)
{
  command(a);     // 0xAE => Sleep Mode ON
                  // 0xAF => Sleep Mode OFF
}
//--------------------------------------------------------------------------

void Set_Phase_Length_25664(unsigned char a)
{
  command(0xB1);  // Set Phase Length
  data(a);        // Default => 0x97
}
//--------------------------------------------------------------------------

void Set_Display_Clock__Oscillator_Frequency_25664(unsigned char a)
{
  command(0xB3);  // Set Osc Frequency
  data(a);        //
}
//--------------------------------------------------------------------------

void Enable_External_VSL(unsigned char a, unsigned char b)
{
  command(0xB4);  // Enable External VSL
  data(a);        //
  data(b);        //
}
//--------------------------------------------------------------------------

void Set_GPIO_25664(unsigned char a)
{
  command(0xB5);  // Set GPIO
  data(a);        //
}
//--------------------------------------------------------------------------

void Set_Second_Precharge_Period_25664(unsigned char a)
{
  command(0xB6);  // Set Second Precharge Period
  data(a);        //
}
//--------------------------------------------------------------------------

void Default_Grayscale_Command_25664()
{
  command(0xB9);  // Sets Default Grayscale
}
//--------------------------------------------------------------------------

void Set_Precharge_Voltage_25664(unsigned char a)
{
  command(0xBB);  // Set Precharge Voltage Level
  data(a);        // Default => 0x17
}
//--------------------------------------------------------------------------

void Set_VCOMH_Voltage_25664(unsigned char a)
{
  command(0xBE);  // Set Second Precharge Period
  data(a);        // Default => 0x04
}
//--------------------------------------------------------------------------

void Set_Contrast_Control_25664(unsigned char a)
{
  command(0xC1);  // Set Contrast Control Level
  data(a);        // Default => 0x7F
}
//--------------------------------------------------------------------------

void Master_Contrast_Control_25664(unsigned char a)
{
  command(0xC7);  // Master Contrast Control
  data(a);        // Default => 0x0F
}
//--------------------------------------------------------------------------

void Set_Multiplex_Ratio_25664(unsigned char a)
{
  command(0xCA);  // Set MUX Ratio
  data(a);        // Default => 0x7F
}
//--------------------------------------------------------------------------

void Display_Enhancement_25664(unsigned char a)
{
  command(0xD1);  // Display Enhancement
  data(a);        //
  data(0x20);     //
}
//--------------------------------------------------------------------------

void Set_Command_Lock_25664(unsigned char a)
{
  command(0xFD);  // Set Lock/Unlock Commands
  data(a);        // Default => 0x12
}
//--------------------------------------------------------------------------


//-=-=-=-=-=-=-=-=-=-=-=-=-=-=-=-=-=-=-=-=-=-=-=-=-=-=-=-=-=-=-=-=-=-=-=
//  Show Blank (Clear Screen)
//-=-=-=-=-=-=-=-=-=-=-=-=-=-=-=-=-=-=-=-=-=-=-=-=-=-=-=-=-=-=-=-=-=-=-=

void ClearPixel_25664()
{
  unsigned int i, j;

  Set_Column_Address_25664(0x1C,0x5B);
  Set_Row_Address_25664(0x00,0x3F);
  Set_Write_RAM_25664();

  for(i=0;i<64;i++) //Columns
  {
    for(j=0;j<128;j++) //Rows
    {
      data(0x00);
      //HAL_Delay(1);
    }
  }
}

//-=-=-=-=-=-=-=-=-=-=-=-=-=-=-=-=-=-=-=-=-=-=-=-=-=-=-=-=-=-=-=-=-=-=-=
//  Show Checkboard (Full Screen)
//-=-=-=-=-=-=-=-=-=-=-=-=-=-=-=-=-=-=-=-=-=-=-=-=-=-=-=-=-=-=-=-=-=-=-=

void FillPixel_25664()
{
  unsigned int i, j;

  Set_Column_Address_25664(0x1C,0x5B); //1C & 5B = DISPLAY Start & End address.
  Set_Row_Address_25664(0x00,0x3F);
  Set_Write_RAM_25664();

  for(i=0;i<32;i++) //Columns
  {
    for(j=0;j<64;j++) //Rows
    {
      data(0xFF);
      //HAL_Delay(1);
      data(0x00);
      //HAL_Delay(1);
    }
    for(j=0;j<64;j++) //Rows
    {
      data(0x00);
      //HAL_Delay(1);
      data(0xFF);
      //HAL_Delay(1);
    }
  }
}

//-=-=-=-=-=-=-=-=-=-=-=-=-=-=-=-=-=-=-=-=-=-=-=-=-=-=-=-=-=-=-=-=-=-=-=
//  Show Image (Full Screen)
//-=-=-=-=-=-=-=-=-=-=-=-=-=-=-=-=-=-=-=-=-=-=-=-=-=-=-=-=-=-=-=-=-=-=-=
//  4 bits (1 Nibble) = 1 Pixel
//-=-=-=-=-=-=-=-=-=-=-=-=-=-=-=-=-=-=-=-=-=-=-=-=-=-=-=-=-=-=-=-=-=-=-=

void ImageDisplay_25664(unsigned char *image)
{
  unsigned int i, j, buff;
  //Set_Remap_25664(0x14,0x11);
  Set_Remap_25664(0x06,0x11); // To Flip Orientation 180 Degrees
  Set_Column_Address_25664(0x1C,0x5B);
  Set_Row_Address_25664(0x00,0x3F);
  Set_Write_RAM_25664();

  for(i=0;i<64;i++) //Columns
  {
    for(j=0;j<32;j++) //Rows
    {
      buff = *image;
      buff = ((buff >> 6) & 0x03);
      if(buff == 0x03){data(0xFF);}
      else if(buff == 0x02){data(0xF0);}
      else if(buff == 0x01){data(0x0F);}
      else data(0x00);

      buff = *image;
      buff = ((buff >> 4) & 0x03);
      if(buff == 0x03){data(0xFF);}
      else if(buff == 0x02){data(0xF0);}
      else if(buff == 0x01){data(0x0F);}
      else data(0x00);

      buff = *image;
      buff = ((buff >> 2) & 0x03);
      if(buff == 0x03){data(0xFF);}
      else if(buff == 0x02){data(0xF0);}
      else if(buff == 0x01){data(0x0F);}
      else data(0x00);

      buff = *image;
      buff = (buff & 0x03);
      if(buff == 0x03){data(0xFF);}
      else if(buff == 0x02){data(0xF0);}
      else if(buff == 0x01){data(0x0F);}
      else data(0x00);

      image++;
    }
  }
}

/****************************************************
*           Initialization For controller           *
*****************************************************/

void OLED_Init_25664()
{
  Set_Command_Lock_25664(0x12);                             // Unlock commands for OLED
  Set_Display_Clock__Oscillator_Frequency_25664(0xD1);      // Set Display Clock / Oscillator Frequency
  Set_Multiplex_Ratio_25664(0x3F);                          // Set Multiplex Ratio
  Set_Display_Offset_25664(0x00);                           // Set Display Offset
  Set_Display_Start_Line_25664(0x00);                       // Set Display Start Line
  Set_Remap_25664(0x14,0x11);                               // Set Remap. (A[1]) & (A[4]) can be adjusted to flip display orientation
  Set_GPIO_25664(0x00);                                     // Set GPIO
  Function_Selection_25664(0x00);                           // Function Selection
  Enable_External_VSL(0xA0,0xB5);                           // Enable External VSL
  Set_Contrast_Control_25664(0x9F);                         // Set Contrast Control
  Master_Contrast_Control_25664(0x0F);                      // Master Contrast Control
  Default_Grayscale_Command_25664();                        // Default Linear Grayscale Table
  Set_Phase_Length_25664(0x74);                             // Set Phase Length
  Display_Enhancement_25664(0xA2);                          // Display Enhancement
  Set_Precharge_Voltage_25664(0x17);                        // Set Precharge Voltage
  Set_Second_Precharge_Period_25664(0x08);                  // Set Second Precharge Period
  Set_VCOMH_Voltage_25664(0x07);                            // Set VCOMH Voltage
  Display_Mode_25664(0xA6);                                 // Set Normal Display
  Exit_Partial_Display_25664();                             // Exit Partial Display Mode
  Set_Sleep_Mode_25664(0xAF);                               // Sleep Mode OFF
}

/*****************************************************
*           Setup Function, to run once              *
*****************************************************/

void display_setup()
{


  HAL_GPIO_WritePin(GPIOA, DISP_GPIO_RS_Pin, 0);
  HAL_Delay(2);
  HAL_GPIO_WritePin(GPIOA, DISP_GPIO_RS_Pin, 1);
  HAL_Delay(1);
  HAL_GPIO_WritePin(GPIOA, DISP_GPIO_CS_Pin, 0);
  HAL_Delay(1);
  OLED_Init_25664(); //Initialization Sequence

}

/*****************************************************
*           Loop Function, to run repeatedly         *
*****************************************************/

void imageTestLoop() {

	FillPixel_25664();
	HAL_Delay(1000);
	display_clear();
	HAL_Delay(1000);
	display_test();
	HAL_Delay(5000);
	display_clear();
	HAL_Delay(1000);

}



/*****************************************************
*           Extension Functions                      *
*****************************************************/

void display_test(){
	ImageDisplay_25664(NHD_Logo);
}

void display_clear(){
	ClearPixel_25664();
}

void display_command(unsigned char a){
	Display_Mode_25664(a);
}

void display_image(unsigned char *image){
	ImageDisplay_25664(image);
}

//updates the display, sending the latest data from image buffer
void update_display(){
	display_image(buffer);
}

//sets the given pixel to 0 (off) or 1 (on)
//Pixel 255 is the rightmost pixel of the first row
//Pixel 256 is the leftmost pixel of the second row
void set_rawpixel(int pixelNum, _Bool value){
	int bytenum = pixelNum/8;
	int shift = pixelNum%8;
	char dat = buffer[bytenum];
	unsigned int mask = 1 << shift;
	if (value)
	    dat |= mask;    // set the bit
	else
	    dat &= ~mask;   // clear the bit

	buffer[bytenum] = dat;
}

int invalid=0;//number of invalid calls

//sets the given pixel to 0 (off) or 1 (on)
//Pixel 0,0 is the top-left-most pixel.
//pixel 255,63 is the bottom-right-most pixel
void set_pixel(int x, int y, _Bool value){
	//prevent invalid calls
	if(x>255 || x<0 || y<0 || y>63){ invalid++; return; };
	int raw = y * 256 +x;
}

//sets 12 pixels
void twelve_write(int x, int y, int dat){
	if(x>243 || x<0 || y<0 || y>63){ invalid++; return; };
	int raw = y * 256 +x;
	int i;
	for(i=1; i<2049; i*2){
		_Bool value = dat & i;
		set_rawpixel(raw,value);
	}
}
